## CMakeLists.txt
```
#
# Copyright (c) 2020 Nordic Semiconductor
#
# SPDX-License-Identifier: LicenseRef-BSD-5-Clause-Nordic
#

cmake_minimum_required(VERSION 3.8.2)

#configuration for secure side
if (EXISTS "${CMAKE_CURRENT_SOURCE_DIR}/spm.conf")
  set(spm_CONF_FILE
    prj.conf
    ${CMAKE_CURRENT_LIST_DIR}/spm.conf
  )
endif()

#if(CONFIG_POSIX_API)
#  target_include_directories(posix_subsys INTERFACE ${ZEPHYR_BASE}/include/posix)
#endif()

find_package(Zephyr REQUIRED HINTS $ENV{ZEPHYR_BASE})
project(FTA)
target_include_directories(app PRIVATE
  ${CMAKE_CURRENT_SOURCE_DIR}/src
  ${CMAKE_CURRENT_SOURCE_DIR}/iperf
  ${CMAKE_CURRENT_SOURCE_DIR}/ping
  ${CMAKE_CURRENT_SOURCE_DIR}/utils
  ${CMAKE_CURRENT_SOURCE_DIR}/utils/freebsd-getopt)

target_sources(app PRIVATE src/main.c)
target_sources(app PRIVATE src/shell.c)
target_sources(app PRIVATE src/at/at_shell.c)
target_sources(app PRIVATE src/utils/fta_net_utils.c)
target_sources(app PRIVATE src/utils/fta_time_utils.c)
target_sources(app PRIVATE src/utils/freebsd-getopt/getopt.c)
target_sources(app PRIVATE src/utils/freebsd-getopt/getopt_long.c)

add_subdirectory_ifdef(CONFIG_FTA_SOCK src/sock)
add_subdirectory_ifdef(CONFIG_FTA_LTELC src/ltelc)
add_subdirectory_ifdef(CONFIG_FTA_PING src/ping)
add_subdirectory_ifdef(CONFIG_FTA_CURL src/curl)
add_subdirectory_ifdef(CONFIG_FTA_IPERF3 src/iperf)
add_subdirectory_ifdef(CONFIG_FTA_GNSS src/gnss)
add_subdirectory_ifdef(CONFIG_FTA_PPP src/ppp)
```

## Kconfig
```
#
# Copyright (c) 2020 Nordic Semiconductor ASA
#
# SPDX-License-Identifier: LicenseRef-BSD-5-Clause-Nordic
#

source "Kconfig.zephyr"

menu "Nordic FTA config"

config FTA_IPERF3
	bool  "Enable FTA iperf3 support"
    default y

config FTA_SOCK
	bool  "Enable FTA socket tool support"
    default y

config FTA_PING
	bool  "Enable FTA ICMP ping support"
    default y

config FTA_LTELC
	bool  "Enable FTA LTE link control support"
    default y

config FTA_CURL
	bool  "Enable CURL"
    default y

config FTA_GNSS
	bool  "Enable GNSS support"
	default y

config FTA_PPP
	bool  "Enable PPP support"
#	select NET_RAW_MODE
	default y

if FTA_IPERF3
menu "FTA iperf3 selections"

config FTA_IPERF3_HOST_NAME
	string "configure host name for iperf3 to be sent as a part of cookie"
	default "nrf9160"

config FTA_IPERF3_RESULTS_WAIT_TIME
	int "Configure the time to be waited to send and recv results"
	default 15

config FTA_IPERF3_CLIENT_TEST_START_TIME
	int "Configure the time to be waited after ctrl socket has been created to actual test start"
	default 15

#invisible configs:
config FTA_IPERF3_NONBLOCKING_CLIENT_CHANGES
	bool
    default y

config FTA_IPERF3_FUNCTIONAL_CHANGES
	bool
    default y
	
endmenu #FTA iperf3
endif #FTA_IPERF3


if FTA_CURL
menu "FTA CURL selections"

#invisible configs:
config FTA_CURL_LIB
	bool
    default y

config FTA_CURL_TOOL
	bool
    default y

config FTA_CURL_FUNCTIONAL_CHANGES
	bool
    default y

endmenu #FTA CURL
endif #FTA_CURL

endmenu #FTA

#menu "Zephyr Kernel"
#source "Kconfig.zephyr"
#endmenu
```

## prj.conf
```kconfig
#
# Copyright (c) 2020 Nordic Semiconductor ASA
#
# SPDX-License-Identifier: LicenseRef-BSD-5-Clause-Nordic
#
# General config

CONFIG_FTA_IPERF3=y
CONFIG_FTA_SOCK=y
CONFIG_FTA_PING=y
CONFIG_FTA_CURL=y

#ref: https://docs.zephyrproject.org/1.13.0/reference/kconfig/CONFIG_SYS_CLOCK_TICKS_PER_SEC.html#cmdoption-arg-config-sys-clock-ticks-per-sec
#CONFIG_SYS_CLOCK_TICKS_PER_SEC=1000 #b_jh: without this there is a default 32k? duw to some hw driver? 

CONFIG_SHELL=y
CONFIG_SHELL_WILDCARD=n
CONFIG_SHELL_PROMPT_UART="uart-mosh:~$ "

#note: setting this higher caused problems? SOme relation to ending handshakle timings? server has cvlosed the connection?
CONFIG_SHELL_ARGC_MAX=16
CONFIG_SHELL_DEFAULT_TERMINAL_WIDTH=160
CONFIG_SHELL_DEFAULT_TERMINAL_HEIGHT=48
CONFIG_UART_SHELL_ON_DEV_NAME="UART_1"
CONFIG_UART_CONSOLE_ON_DEV_NAME="UART_1"
#CONFIG_SHELL_LOG_LEVEL_DBG=y
#CONFIG_SHELL_PRINTF_BUFF_SIZE=60

#it is this that is having impact for FTA shell appl, not the CONFIG_MAIN_STACK_SIZE
CONFIG_SHELL_STACK_SIZE=16384

CONFIG_MINIMAL_LIBC=n
CONFIG_NEWLIB_LIBC=y #needed with CONFIG_FTA_IPERF3
CONFIG_NEWLIB_LIBC_FLOAT_SCANF=y #needed with CONFIG_FTA_IPERF3
CONFIG_NEWLIB_LIBC_FLOAT_PRINTF=y #needed with CONFIG_FTA_IPERF3

# Modem info
CONFIG_MODEM_INFO=y

# Network
CONFIG_NETWORKING=y

CONFIG_NET_NATIVE=n
CONFIG_NET_SOCKETS=y
CONFIG_NET_SOCKETS_OFFLOAD=y

CONFIG_POSIX_API=y #needed with CONFIG_FTA_IPERF3
CONFIG_PTHREAD_IPC=n #b_jh: had issues with posix api, needed as n with CONFIG_FTA_IPERF3
CONFIG_POSIX_MAX_FDS=10

#need to be the same as MAX_FDS
CONFIG_NET_SOCKETS_POLL_MAX=10

# BSD library
CONFIG_BSD_LIBRARY=y

#enable for "fidoless"
CONFIG_BSD_LIBRARY_TRACE_ENABLED=n

# Modem library
#CONFIG_LIBMODEM=y
#CONFIG_LIBMODEM_HEAP_SIZE=2048
#CONFIG_LIBMODEM_SHMEM_TX_SIZE=8192
#CONFIG_LIBMODEM_SHMEM_RX_SIZE=4096
#CONFIG_LIBMODEM_TRACE_ENABLED=n

CONFIG_NET_SOCKETS_POSIX_NAMES=n #b_jh: needed as n with CONFIG_FTA_IPERF3

#for lte connection and other stuff that are using system queue
CONFIG_SYSTEM_WORKQUEUE_STACK_SIZE=8192

#PPP
CONFIG_NET_SHELL=y


CONFIG_NET_NATIVE=y
#CONFIG_NET_SOCKETS_PACKET=y
CONFIG_NET_STATISTICS=y
CONFIG_NET_LOG=y
CONFIG_NET_CONFIG_AUTO_INIT=y
CONFIG_NET_PPP_MTU_MRU=1280

#CONFIG_LOG_PROCESS_THREAD_STACK_SIZE=2048

#CONFIG_UART_PIPE=y
#CONFIG_UART_PIPE_ON_DEV_NAME="UART_0"

CONFIG_NET_DEFAULT_IF_PPP=y
CONFIG_NET_L2_PPP_OPTION_DNS_USE=n
CONFIG_NET_L2_PPP=y
CONFIG_NET_L2_PPP_MGMT=y
CONFIG_NET_L2_PPP_DELAY_STARTUP_MS=5000

CONFIG_NET_PPP=y
CONFIG_NET_PPP_DRV_NAME="ppp-mosh"

CONFIG_NET_PPP_RINGBUF_SIZE=9216
CONFIG_NET_PPP_RX_STACK_SIZE=2048
#CONFIG_NET_PPP_UART_BUF_LEN=128
#CONFIG_UART_0_NRF_TX_BUFFER_SIZE=128
#CONFIG_NET_PPP_RX_PRIORITY=0
#CONFIG_UART_MUX_RX_STACK_SIZE=1280
#CONFIG_UART_MUX_RX_PRIORITY=5
#CONFIG_SHELL_BACKEND_SERIAL_TX_RING_BUFFER_SIZE=128
#CONFIG_SHELL_BACKEND_SERIAL_RX_RING_BUFFER_SIZE=128

#CONFIG_NET_RX_STACK_SIZE=2800
#CONFIG_NET_TX_STACK_SIZE=2800
#CONFIG_NET_BUF_FIXED_DATA_SIZE=y

# Network buffers
CONFIG_NET_BUF=y
#CONFIG_NET_TX_DEFAULT_PRIORITY=5
#CONFIG_NET_RX_DEFAULT_PRIORITY=6

CONFIG_NET_BUF_LOG=y
CONFIG_NET_BUF_LOG_LEVEL_WRN=y
CONFIG_NET_BUF_WARN_ALLOC_INTERVAL=2

CONFIG_NET_PKT_RX_COUNT=8
CONFIG_NET_BUF_RX_COUNT=14

CONFIG_NET_PKT_TX_COUNT=4
CONFIG_NET_BUF_TX_COUNT=8

CONFIG_NET_BUF_DATA_SIZE=512

CONFIG_NET_DEBUG_NET_PKT_ALLOC=y
CONFIG_NET_BUF_POOL_USAGE=y

CONFIG_PPP_CLIENT_CLIENTSERVER=y

CONFIG_NET_STATISTICS_PPP=y
CONFIG_NET_STATISTICS_USER_API=y

# IPv4 enables PPP IPCP support: TODO, to be based on CONFIG_NET_OFFLOAD??
CONFIG_NET_IPV4=n
CONFIG_NET_OFFLOAD=y
#CONFIG_NET_CONFIG_NEED_IPV4=y
CONFIG_NET_IPV6=n

# Debug options in order to see the sent and received packets
CONFIG_NET_PPP_LOG_LEVEL_WRN=y
CONFIG_NET_L2_PPP_LOG_LEVEL_WRN=y
CONFIG_NET_CORE_LOG_LEVEL_WRN=y
CONFIG_NET_IF_LOG_LEVEL_WRN=y
CONFIG_NET_PKT_LOG_LEVEL_WRN=y
#CONFIG_NET_DEBUG_NET_PKT_ALLOC=y
CONFIG_NET_CONTEXT_LOG_LEVEL_WRN=y
CONFIG_UART_CONSOLE_LOG_LEVEL_WRN=y
CONFIG_NET_BUF_LOG_LEVEL_WRN=y


#CONFIG_NET_CONTEXT_NET_PKT_POOL=y
#CONFIG_NET_BUF_VARIABLE_DATA_SIZE=y
#CONFIG_NET_BUF_FIXED_DATA_SIZE=n

#CONFIG_UART_PIPE_ON_DEV_NAME="UART_0"
CONFIG_NET_PPP_UART_NAME="UART_0"

# UART interface
#CONFIG_UART_ASYNC_API=y
#CONFIG_UART_0_ASYNC=y
#CONFIG_UART_1_ASYNC=n
#CONFIG_UART_0_NRF_HW_ASYNC=y
#CONFIG_UART_1_NRF_HW_ASYNC=n
#CONFIG_UART_0_INTERRUPT_DRIVEN=n
#CONFIG_UART_0_NRF_HW_ASYNC_TIMER=1


#PPP end
#CONFIG_NRFX_UARTE0=y

######################
# AT commands
CONFIG_AT_CMD=y
CONFIG_AT_CMD_THREAD_STACK_SIZE=2048
#CONFIG_IDLE_STACK_SIZE=1024
#CONFIG_AT_CMD_LOG_LEVEL_DBG=y
#CONFIG_DNS_RESOLVER=y
#CONFIG_DNS_SERVER_IP_ADDRESSES=y
#CONFIG_DNS_SERVER1="8.8.8.8"
#CONFIG_DNS_SERVER2="8.8.4.4"

#CONFIG_NET_IF_MAX_IPV4_COUNT=2

# Network address config
CONFIG_NET_CONFIG_SETTINGS=y
#CONFIG_NET_CONFIG_NEED_IPV4=y
#CONFIG_NET_CONFIG_MY_IPV4_ADDR="200.0.6.6"
#CONFIG_NET_CONFIG_PEER_IPV4_ADDR="192.0.2.2"
#CONFIG_NET_CONFIG_MY_IPV4_GW="192.0.2.2"
#CONFIG_STACK_USAGE=y

# Stacks and heaps
CONFIG_MAIN_STACK_SIZE=4096
CONFIG_HEAP_MEM_POOL_SIZE=28672

# LTE link control
CONFIG_LTE_LINK_CONTROL=y
CONFIG_LTE_AUTO_INIT_AND_CONNECT=y
CONFIG_LTE_NETWORK_MODE_LTE_M_GPS=y
#CONFIG_LTE_LOCK_PLMN=y
#CONFIG_LTE_LOCK_PLMN_STRING="24405"

#CONFIG_LTE_PDP_CMD=y
#CONFIG_LTE_PDP_CONTEXT="0,\"IPv4v6\",\"julkinen.dna.fi\""

# GPS driver
CONFIG_NRF9160_GPS=y
# Initialize GPS driver before LTE LC
CONFIG_NRF9160_GPS_INIT_PRIO=40
#CONFIG_NRF9160_GPS_ANTENNA_EXTERNAL=y
CONFIG_NRF9160_GPS_NMEA_GSV=y
CONFIG_NRF9160_GPS_NMEA_GSA=y
CONFIG_NRF9160_GPS_NMEA_GLL=y
CONFIG_NRF9160_GPS_NMEA_GGA=y
CONFIG_NRF9160_GPS_NMEA_RMC=y

# debugging
CONFIG_ASSERT=n
CONFIG_LOG=y
CONFIG_DEBUG_INFO=y
#CONFIG_LOG_PROCESS_THREAD_STACK_SIZE=2048

#CONFIG_DEBUG_OPTIMIZATIONS=y
#CONFIG_NO_OPTIMIZATIONS=y

#CONFIG_FORCE_NO_ASSERT=y
CONFIG_ASSERT_VERBOSE=n
#CONFIG_ASSERT_LEVEL=2
#CONFIG_ASSERT_ON_ERRORS=y
#CONFIG_FAULT_DUMP=2
CONFIG_RESET_ON_FATAL_ERROR=n
CONFIG_EXTRA_EXCEPTION_INFO=y
#CONFIG_WATCHDOG=y
```

## spm.conf
```kconfig
CONFIG_LOG=y
CONFIG_LOG_MINIMAL=y
CONFIG_RESET_ON_FATAL_ERROR=n
```

## src/main.c
```c
/*
 * Copyright (c) 2020 Nordic Semiconductor ASA
 *
 * SPDX-License-Identifier: LicenseRef-BSD-5-Clause-Nordic
 */

#include <stdio.h>
#include <string.h>

#include <zephyr.h>
#include <init.h>

#include <sys/types.h>
#include <nrf9160.h>
#include <hal/nrf_gpio.h>
#include <logging/log_ctrl.h>

#include <modem/modem_info.h>
#include <modem/lte_lc.h>
#include "ltelc.h"

/* global variables */
struct modem_param_info modem_param;

#if !defined (CONFIG_RESET_ON_FATAL_ERROR)
#if 0
void k_sys_fatal_error_handler(unsigned int reason,
			       const z_arch_esf_t *esf)
{
//	ARG_UNUSED(esf);

	LOG_PROCESS();
	LOG_PANIC();
	printk("OHO! Running main.c error handler, reason: %d", reason);
	z_fatal_error(reason, esf);
//	k_fatal_halt(reason);
//	CODE_UNREACHABLE;
}
#endif
#endif

static void modem_trace_enable(void)
{
/* GPIO configurations for trace and debug */
#define CS_PIN_CFG_TRACE_CLK 21 //GPIO_OUT_PIN21_Pos
#define CS_PIN_CFG_TRACE_DATA0 22 //GPIO_OUT_PIN22_Pos
#define CS_PIN_CFG_TRACE_DATA1 23 //GPIO_OUT_PIN23_Pos
#define CS_PIN_CFG_TRACE_DATA2 24 //GPIO_OUT_PIN24_Pos
#define CS_PIN_CFG_TRACE_DATA3 25 //GPIO_OUT_PIN25_Pos

	// Configure outputs.
	// CS_PIN_CFG_TRACE_CLK
	NRF_P0_NS->PIN_CNF[CS_PIN_CFG_TRACE_CLK] =
		(GPIO_PIN_CNF_DRIVE_H0H1 << GPIO_PIN_CNF_DRIVE_Pos) |
		(GPIO_PIN_CNF_INPUT_Disconnect << GPIO_PIN_CNF_INPUT_Pos);

	// CS_PIN_CFG_TRACE_DATA0
	NRF_P0_NS->PIN_CNF[CS_PIN_CFG_TRACE_DATA0] =
		(GPIO_PIN_CNF_DRIVE_H0H1 << GPIO_PIN_CNF_DRIVE_Pos) |
		(GPIO_PIN_CNF_INPUT_Disconnect << GPIO_PIN_CNF_INPUT_Pos);

	// CS_PIN_CFG_TRACE_DATA1
	NRF_P0_NS->PIN_CNF[CS_PIN_CFG_TRACE_DATA1] =
		(GPIO_PIN_CNF_DRIVE_H0H1 << GPIO_PIN_CNF_DRIVE_Pos) |
		(GPIO_PIN_CNF_INPUT_Disconnect << GPIO_PIN_CNF_INPUT_Pos);

	// CS_PIN_CFG_TRACE_DATA2
	NRF_P0_NS->PIN_CNF[CS_PIN_CFG_TRACE_DATA2] =
		(GPIO_PIN_CNF_DRIVE_H0H1 << GPIO_PIN_CNF_DRIVE_Pos) |
		(GPIO_PIN_CNF_INPUT_Disconnect << GPIO_PIN_CNF_INPUT_Pos);

	// CS_PIN_CFG_TRACE_DATA3
	NRF_P0_NS->PIN_CNF[CS_PIN_CFG_TRACE_DATA3] =
		(GPIO_PIN_CNF_DRIVE_H0H1 << GPIO_PIN_CNF_DRIVE_Pos) |
		(GPIO_PIN_CNF_INPUT_Disconnect << GPIO_PIN_CNF_INPUT_Pos);

	NRF_P0_NS->DIR = 0xFFFFFFFF;
}
static int fta_shell_init(const struct device *unused)
{
	int err = 0;

	ARG_UNUSED(unused);

	printk("\nThe FT app sample started\n\n");

	modem_trace_enable();

#if defined(CONFIG_LTE_LINK_CONTROL)
	ltelc_init();

	lte_lc_register_handler(ltelc_ind_handler); //for autoconnect
#endif

#if defined(CONFIG_MODEM_INFO)
	err = modem_info_init();
	if (err) {
		printk("\nModem info could not be established: %d", err);
		return err;
	}
	modem_info_params_init(&modem_param);
#endif
	return err;
}

void main(void)
{
#if defined(CONFIG_LTE_LINK_CONTROL)
	int err;
	if (IS_ENABLED(CONFIG_LTE_AUTO_INIT_AND_CONNECT)) {
		/* Do nothing, modem is already configured and LTE connected. */
	} else {
		err = lte_lc_init_and_connect_async(ltelc_ind_handler);
		if (err) {
			printk("\nModem could not be configured, error: %d",
			       err);
			return;
		}

		/* Check LTE events of type LTE_LC_EVT_NW_REG_STATUS in
		 * lte_async_connect_handler() to determine when the LTE link is up.
		 */
	}
#endif
}

SYS_INIT(fta_shell_init, APPLICATION, CONFIG_APPLICATION_INIT_PRIORITY);
```

## src/fta_defines.h
```c
#ifndef FTA_DEFINES_H
#define FTA_DEFINES_H

#define FTA_EMPTY_STRING "\0"

#define FTA_APN_STR_MAX_LEN (64)
#define FTA_ARG_NOT_SET -6

#define FTA_STRING_NULL_CHECK(string) ((string != NULL) ? string : FTA_EMPTY_STRING)

#endif /* FTA_DEFINES_H */
```

## src/icmp_ping.c
```c
/*
 * Copyright (c) 2020 Nordic Semiconductor ASA
 *
 * SPDX-License-Identifier: LicenseRef-BSD-5-Clause-Nordic
 */
#include <stdio.h>
#include <zephyr.h>
#include <shell/shell.h>

#include <modem/modem_info.h>

#if defined (CONFIG_POSIX_API)
#include <netdb.h>
#include <sys/socket.h>
#else
#if !defined (CONFIG_NET_SOCKETS_POSIX_NAMES)
#include <posix/netdb.h>
#include <posix/sys/socket.h>
#else
#include <net/socket.h>
#endif
#endif
#include <nrf_socket.h>

#include "icmp_ping.h"

#define ICMP    1               // Protocol
#define ICMP6   6
#define ICMPV6  58              // Next Header
#define IP_NEXT_HEADER_POS  6   // Next Header
#define IP_PROTOCOL_POS     9   // Protocol
#define ICMP_ECHO_REP       0
#define ICMP_ECHO_REQ       8
#define ICMP6_ECHO_REQ      128
#define ICMP6_ECHO_REP      129

/**@ ICMP Ping command arguments */
static struct ping_argv_t {
	char target_name[ICMP_MAX_URL];
	struct addrinfo *src;
	struct addrinfo *dest;
	const struct shell *shell;
	int len;
	int waitms;
	int count;
	int interval;
} ping_argv;

/* global variable defined in different files */
extern struct modem_param_info modem_param;
extern char rsp_buf[CONFIG_AT_CMD_RESPONSE_MAX_LEN];

//TODO: to tools
static char *sckt_addr_ntop(const struct sockaddr *addr)
{
	static char buf[NET_IPV6_ADDR_LEN];

	if (addr->sa_family == AF_INET6) {
		return net_addr_ntop(AF_INET6, &net_sin6(addr)->sin6_addr, buf,
				     sizeof(buf));
	}

	if (addr->sa_family == AF_INET) {
		return net_addr_ntop(AF_INET, &net_sin(addr)->sin_addr, buf,
				     sizeof(buf));
	}

	//LOG_ERR("Unknown IP address family:%d", addr->sa_family);
	strcpy(buf, "Unknown AF");
	return buf;
}

static inline void setip(uint8_t *buffer, uint32_t ipaddr)
{
	buffer[0] = ipaddr & 0xFF;
	buffer[1] = (ipaddr >> 8) & 0xFF;
	buffer[2] = (ipaddr >> 16) & 0xFF;
	buffer[3] = ipaddr >> 24;
}

static uint16_t check_ics(const uint8_t *buffer, int len)
{
	const uint32_t *ptr32 = (const uint32_t *)buffer;
	uint32_t hcs = 0;
	const uint16_t *ptr16;

	for (int i = len / 4; i > 0; i--) {
		uint32_t s = *ptr32++;

		hcs += s;
		if (hcs < s) {
			hcs++;
		}
	}

	ptr16 = (const uint16_t *)ptr32;

	if (len & 2) {
		uint16_t s = *ptr16++;

		hcs += s;
		if (hcs < s) {
			hcs++;
		}
	}

	if (len & 1) {
		const uint8_t *ptr8 = (const uint8_t *)ptr16;
		uint8_t s = *ptr8;

		hcs += s;
		if (hcs < s) {
			hcs++;
		}
	}

	while (hcs > 0xFFFF) {
		hcs = (hcs & 0xFFFF) + (hcs >> 16);
	}

	return ~hcs; /* One's complement */
}

static void calc_ics(uint8_t *buffer, int len, int hcs_pos)
{
	uint16_t *ptr_hcs = (uint16_t *)(buffer + hcs_pos);
	*ptr_hcs = 0; /* Clear checksum before calculation */
	uint16_t hcs;

	hcs = check_ics(buffer, len);
	*ptr_hcs = hcs;
}

static uint32_t send_ping_wait_reply(const struct shell *shell)
{
	static int64_t start_t, delta_t;
    static uint8_t seqnr = 0;
    uint16_t total_length;
    uint8_t *buf = NULL;
    uint8_t *data = NULL;
    uint8_t rep = 0;
    uint8_t header_len = 0;
    struct addrinfo *si = ping_argv.src;
    const int alloc_size = 1280;        // MTU
  	struct nrf_pollfd fds[1];
	int dpllen, pllen, len;
	int fd;
	int hcs;
	int plseqnr;
	int ret;
	const uint16_t icmp_hdr_len = 8;

    if (si->ai_family == AF_INET)
    {
        // Generate IPv4 ICMP EchoReq

        // Ping header
        header_len = 20;

        total_length = ping_argv.len + header_len + icmp_hdr_len;

        buf = calloc(1, alloc_size);

        buf[0] = (4 << 4) + (header_len / 4);   // Version & header length
        //buf[1] = 0;                           // Type of service
        buf[2] = total_length >> 8;             // Total length
        buf[3] = total_length & 0xFF;           // Total length
        //buf[4..5] = 0;                        // Identification
        //buf[6..7] = 0;                        // Flags & fragment offset
        buf[8] = 64;                            // TTL
        buf[9] = ICMP;                          // Protocol
        //buf[10..11] = ICS, calculated later

        struct sockaddr_in *sa = (struct sockaddr_in *)ping_argv.src->ai_addr;
        setip(buf+12, sa->sin_addr.s_addr);     // Source
        sa = (struct sockaddr_in *)ping_argv.dest->ai_addr;
        setip(buf+16, sa->sin_addr.s_addr);     // Destination

        calc_ics(buf, header_len, 10);

        // ICMP header
        data = buf + header_len;
        data[0] = ICMP_ECHO_REQ;                // Type (echo req)
        //data[1] = 0;                          // Code
        //data[2..3] = checksum, calculated later
        //data[4..5] = 0;                       // Identifier
        //data[6] = 0;                          // seqnr >> 8
        data[7] = ++seqnr;

        // Payload
        for (int i = 8; i < total_length - header_len; i++)
        {
            data[i] = (i + seqnr) % 10 + '0';
        }

        // ICMP CRC
        calc_ics(data, total_length - header_len, 2);

        rep = ICMP_ECHO_REP;
    }
	else
	{
        // Generate IPv6 ICMP EchoReq

        // Ping header
        header_len = 40;
        uint16_t payload_length = ping_argv.len + icmp_hdr_len;

        total_length = payload_length + header_len;
        buf = calloc(1, alloc_size);

        buf[0] = (6 << 4);                      // Version & traffic class 4 bits
        //buf[1..3] = 0;                        // Traffic class 4 bits & flow label
        buf[4] = payload_length >> 8;           // Payload length
        buf[5] = payload_length & 0xFF;         // Payload length
        buf[6] = ICMPV6;                        // Next header (58)
        buf[7] = 64;                            // Hop limit

        struct sockaddr_in6 *sa = (struct sockaddr_in6 *)ping_argv.src->ai_addr;
        memcpy(buf + 8, sa->sin6_addr.s6_addr, 16);     // Source address

        sa = (struct sockaddr_in6 *)ping_argv.dest->ai_addr;
        memcpy(buf + 24, sa->sin6_addr.s6_addr, 16);    // Destination address

        // ICMP6 header
        data = buf + header_len;
        data[0] = ICMP6_ECHO_REQ;               // Type (echo req)
        //data[1] = 0;                          // Code
        //data[2..3] = checksum, calculated later
        //data[4..5] = 0;                       // Identifier
        //data[6] = 0;                          // seqnr >> 8
        data[7] = ++seqnr;

        // Payload
        for (int i = 0; i < ping_argv.len; i++)
        {
            data[i + icmp_hdr_len] = (i + seqnr) % 10 + '0';
        }
        
		// ICMP6 CRC
        uint32_t hcs = check_ics(buf + 8, 32);  // Pseudo header source + dest

        hcs += check_ics(buf + 4, 2);           // Pseudo header packet length
        uint8_t tbuf[2];
        tbuf[1] = 0; tbuf[1] = buf[6];
        hcs += check_ics(tbuf, 2);              // Pseudo header Next header
        hcs += check_ics(data, 2);              // Type & Code
        hcs += check_ics(data + 4, 4 + ping_argv.len);  // Header data + Data

        while(hcs > 0xFFFF)
            hcs = (hcs & 0xFFFF) + (hcs >> 16);

        data[2] = hcs & 0xFF;
        data[3] = hcs >> 8;

        rep = ICMP6_ECHO_REP;
	}

	/* Send the ping */
	errno = 0;
	delta_t = 0;
	start_t = k_uptime_get();

	fd = nrf_socket(NRF_AF_PACKET, NRF_SOCK_RAW, 0);
	if (fd < 0) {
		shell_error(shell, "socket() failed: (%d)", -errno);
	    free(buf);
		return (uint32_t)delta_t;
	}
#ifdef TODO	
        if (argv->pdn >= 0)
        {
            // FIXME: Currently modem (ltenetif.c) does not allow to set
            //        raw socket pdn to the value it already has.
            //        Also getsockopt for raw ip is not (yet) supported.
            int ret = setsockopt(fd, SOL_SOCKET, SO_BINDNET, &argv->pdn, sizeof(int));
            if (ret < 0)
            {
                sprintf((char*)buf, "+NPING ERROR SETSOCKOPT %d %d\r\n", ret, errno);
                ts_queue_at_create_and_send((char*)buf, strlen((char*)buf));
                (void)close(fd);
                break;
            }
        }
#endif

	ret = nrf_send(fd, buf, total_length, 0);
	if (ret <= 0) {
		shell_error(shell, "nrf_send() failed: (%d)", -errno);
		goto close_end;
	}

	fds[0].fd = fd;
	fds[0].events = NRF_POLLIN;
	ret = nrf_poll(fds, 1, ping_argv.waitms);
	if (ret <= 0) {
		shell_error(shell, "nrf_poll() failed: (%d) (%d)", -errno, ret);
		goto close_end;
	}

	/* receive response */
	do {
		len = nrf_recv(fd, buf, alloc_size, 0);
		if (len <= 0) {
			shell_error(shell, "nrf_recv() failed: (%d) (%d)",
				    -errno, len);
			goto close_end;
		}
		if (len < header_len) {
			/* Data length error, ignore "silently" */
			shell_error(shell, "nrf_recv() wrong data (%d)", len);
			continue;
		}
		if ((rep == ICMP_ECHO_REP && buf[IP_PROTOCOL_POS] != ICMP) || 
		    (rep == ICMP6_ECHO_REP && buf[IP_NEXT_HEADER_POS] != ICMPV6)) {
			/* Not ipv4/ipv6 echo reply, ignore silently */
			continue;
		}
		break;
	} while (1);

	delta_t = k_uptime_delta(&start_t);

    if (rep == ICMP_ECHO_REP)
    {
		/* Check ICMP HCS */
		hcs = check_ics(data, len - header_len);
		if (hcs != 0) {
			shell_error(shell, "IPv4 HCS error, hcs: %d, len: %d\r\n", hcs, len);
			delta_t = 0;
			goto close_end;
		}
		pllen = (buf[2] << 8) + buf[3]; // Raw socket payload length
	}
	else
	{
        // Check ICMP6 CRC
        uint32_t hcs = check_ics(buf + 8, 32);  // Pseudo header source + dest
        hcs += check_ics(buf + 4, 2);           // Pseudo header packet length
        uint8_t tbuf[2];
        tbuf[0] = 0; tbuf[1] = buf[6];
        hcs += check_ics(tbuf, 2);              // Pseudo header Next header
        hcs += check_ics(data, 2);              // Type & Code
        hcs += check_ics(data + 4, len - header_len - 4);   // Header data + Data

        while(hcs > 0xFFFF)
            hcs = (hcs & 0xFFFF) + (hcs >> 16);

        int plhcs = data[2] + (data[3] << 8);
		if (plhcs != hcs) {
			shell_error(shell, "IPv6 HCS error: 0x%x 0x%x\r\n", plhcs, hcs);
			delta_t = 0;
			goto close_end;
		}
		/* Raw socket payload length */
        pllen = (buf[4] << 8) + buf[5] + header_len; // Payload length - hdr		

	}
	
	/* Data payload length: */
	dpllen = pllen - header_len - icmp_hdr_len;

	/* Check seqnr and length */
	plseqnr = data[7];
	if (plseqnr != seqnr) {
		shell_error(shell, "error sequence numbers %d %d", plseqnr,
			    seqnr);
		delta_t = 0;
		goto close_end;
	}
	if (pllen != len) {
		shell_error(shell, "error length %d %d", pllen, len);
		delta_t = 0;
		goto close_end;
	}

	/* Result */
	sprintf(rsp_buf,
		"Pinging %s results: time=%d.%03dsecs, payload sent: %d, payload received %d\r\n",
		ping_argv.target_name, (uint32_t)(delta_t) / 1000,
		(uint32_t)(delta_t) % 1000, ping_argv.len, dpllen);

	shell_print_stream(shell, rsp_buf, strlen(rsp_buf));

close_end:
	(void)nrf_close(fd);
	free(buf);
	return (uint32_t)delta_t;
}

static void icmp_ping_tasks_execute(const struct shell *shell)
{
	struct addrinfo *si = ping_argv.src;
	struct addrinfo *di = ping_argv.dest;
	uint32_t sum = 0;
	uint32_t count = 0;

	for (int i = 0; i < ping_argv.count; i++) {
		uint32_t ping_t = send_ping_wait_reply(shell);

		if (ping_t > 0) {
			count++;
			sum += ping_t;
		}
		k_sleep(K_MSEC(ping_argv.interval));
	}

#ifdef NOT_IN_FTA
	if (count > 1) {
		uint32_t avg = (sum + count / 2) / count;
		int avg_s = avg / 1000;
		int avg_f = avg % 1000;

		sprintf("Pinging average %d.%03d\r\n", avg_s, avg_f);
		shell_print_stream(shell, rsp_buf, strlen(rsp_buf));
	}
#endif
	freeaddrinfo(si);
	freeaddrinfo(di);
	sprintf(rsp_buf, "Pinging DONE\r\n");
	shell_print_stream(shell, rsp_buf, strlen(rsp_buf));
}

int icmp_ping_start(const struct shell *shell, const char *target_name,
		    int length, int timeout, int count, int interval)
{
	int st = -1;
	struct addrinfo *res;
	int addr_len;

	shell_print(shell, "initiating ping to: %s", target_name);

#if defined(CONFIG_MODEM_INFO)
	st = modem_info_params_get(&modem_param);
#endif
	if (st < 0) {
		shell_print(shell, "Unable to obtain modem parameters (%d)",
			    st);
		return -1;
	}
	/* Check network connection status by checking local IP address */
	addr_len = strlen(modem_param.network.ip_address.value_string);
	if (addr_len == 0) {
		shell_error(shell, "\nLTE not connected");
		return -1;
	}
	st = getaddrinfo(modem_param.network.ip_address.value_string, NULL,
			 NULL, &res);
	if (st != 0) {
		shell_error(shell, "getaddrinfo(src) error: %d", st);
		return -st;
	}
	ping_argv.src = res;

	/* Get destination */
	res = NULL;
	st = getaddrinfo(target_name, NULL, NULL, &res);
	if (st != 0) {
		shell_error(shell, "getaddrinfo(dest) error: %d", st);
		shell_error(shell, "Cannot resolve remote host\r\n");
		freeaddrinfo(ping_argv.src);
		return -st;
	}
	ping_argv.dest = res;

	if (ping_argv.src->ai_family != ping_argv.dest->ai_family) {
		shell_error(shell, "Source/Destination address family error");
		freeaddrinfo(ping_argv.dest);
		freeaddrinfo(ping_argv.src);
		return -1;
	} else {
		struct sockaddr *sa;
		sa = ping_argv.src->ai_addr;
		shell_print(shell, "Source IP addr: %s", sckt_addr_ntop(sa));
		sa = ping_argv.dest->ai_addr;
		shell_print(shell, "Destination IP addr: %s",
			    sckt_addr_ntop(sa));
	}

	ping_argv.len = length;
	ping_argv.waitms = timeout;
	ping_argv.count = count;
	ping_argv.interval = interval;

	/* Store certain parameters to context: */
	strcpy(ping_argv.target_name, target_name);

	icmp_ping_tasks_execute(shell);
	return 0;
}
```

## src/icmp_ping.h
```c
#ifndef ICMP_PING_H
#define ICMP_PING_H

/*
 * Copyright (c) 2018 Nordic Semiconductor ASA
 *
 * SPDX-License-Identifier: LicenseRef-BSD-5-Clause-Nordic
 */

/**@file icmp_ping.h
 *
 * @brief ICMP ping.
 * @{
 */

#include <zephyr/types.h>

#define ICMP_MAX_URL		128
#define ICMP_MAX_LEN		512
#define ICMP_PARAM_COUNT_DEFAULT 4
/**
 * @brief ICMP AT command parser.
 *
 * @param shell Requesting shell.
 * @param target_name Target domain name.
 *
 * @retval 0 If the operation was successful.
 *           Otherwise, a (negative) error code is returned.
 */
int icmp_ping_start(const struct shell *shell, const char *target_name, int count);

#endif /* ICMP_PING_H */
```

## src/lte_connection.c
```c
/*
 * Copyright (c) 2020 Nordic Semiconductor ASA
 *
 * SPDX-License-Identifier: LicenseRef-BSD-5-Clause-Nordic
 */

#include <stdio.h>
#include <stdlib.h>
#include <string.h>

#include <assert.h>

#include <sys/types.h>
#include <nrf9160.h>
#include <hal/nrf_gpio.h>

#include <shell/shell.h>
#include <shell/shell_uart.h>

#include <modem/modem_info.h>
#include <modem/lte_lc.h>

#include "lte_connection.h"
#include "lte_connection_tools.h"

#if defined(CONFIG_MODEM_INFO)
#include <modem/at_cmd.h>
#include <modem/at_cmd_parser.h>
#include <modem/at_params.h>
#endif

static const struct shell *uart_shell;

#if defined(CONFIG_MODEM_INFO)
/* System work queue for getting the modem info that ain't in lte connection ind.
   TODO: things like these might be good to be in lte connection ind, 
   i.e. merge certain stuff from modem info to there? */

static struct k_work modem_info_work;

/* Work queue for signal info: */
static struct k_work modem_info_signal_work;
static int32_t modem_rsrp;

//**************************************************************************

static void lte_conn_modem_info_work(struct k_work *unused)
{
	ARG_UNUSED(unused);

    k_sleep(K_MSEC(1500)); /* Seems that 1st info read fails without this. Thus, let modem have some time */

	lte_conn_modem_info_get_for_shell(uart_shell);
}
//**************************************************************************

static void lte_conn_rsrp_signal_handler(char rsrp_value)
{

	modem_rsrp = (int8_t)rsrp_value - MODEM_INFO_RSRP_OFFSET_VAL;
	//shell_print(uart_shell, "rsrp:%d", modem_rsrp);
	k_work_submit(&modem_info_signal_work);
}

//**************************************************************************

#define FTA_RSRP_UPDATE_INTERVAL_IN_SECS 5
static void lte_conn_rsrp_signal_update(struct k_work *work)
{
	static uint32_t timestamp_prev = 0;

	if ((timestamp_prev != 0) &&
	    (k_uptime_get_32() - timestamp_prev <
	     FTA_RSRP_UPDATE_INTERVAL_IN_SECS * MSEC_PER_SEC)) {
		return;
	}

	shell_print(uart_shell, "RSRP: %d", modem_rsrp);
	timestamp_prev = k_uptime_get_32();
}
#endif
//**************************************************************************
void lte_conn_init(void)
{
#if defined(CONFIG_MODEM_INFO)
	k_work_init(&modem_info_work, lte_conn_modem_info_work);
	k_work_init(&modem_info_signal_work, lte_conn_rsrp_signal_update);
	modem_info_rsrp_register(lte_conn_rsrp_signal_handler);
#endif
}
//**************************************************************************
const char ltelc_usage_str[] =
	"Usage: ltelc <command> [options]\n"
	"\n"
	"<command> is one of the following:\n"
	"  status:  Show status of the current connection\n"
	"\n"
	"General options:\n"
	"  -i, [int]  socket id. Use 'list' command to see open sockets.\n"
	"\n"
	"Options for 'status' command:\n"
	"  -a, [str]  Address as ip address or hostname\n"
	"\n"
	"Options for 'help' command:\n"
	"  -v, [bool] Show examples\n"
	;

static void lte_conn_shell_print_usage(const struct shell *shell)
{
	shell_print(shell, "%s", ltelc_usage_str);

}
typedef enum {
	LTELC_CMD_STATUS = 0,
	LTELC_CMD_HELP
} ltelc_shell_command;

typedef struct {
	ltelc_shell_command command;
} ltelc_shell_cmd_args_t;

static ltelc_shell_cmd_args_t ltelc_cmd_args;

int lte_conn_shell(const struct shell *shell, size_t argc, char **argv)
{
	int err = 0;
	
	if (argc < 2) {
		lte_conn_shell_print_usage(shell);
		return 0;
	}
	
	// Command = argv[1]
	if (!strcmp(argv[1], "status")) {
		ltelc_cmd_args.command = LTELC_CMD_STATUS;
	} else {
		shell_error(uart_shell, "Unsupported command=%s\n", argv[1]);
		lte_conn_shell_print_usage(shell);
		return -EINVAL;
	}

	switch (ltelc_cmd_args.command) {
		case LTELC_CMD_STATUS:
			lte_conn_modem_info_get_for_shell(shell);
			break;
		default:
			shell_error(shell, "Internal error. Unknown ltelc command=%d", ltelc_cmd_args.command);
			err = -EINVAL;
			break;
	}
	return err;
}
//**************************************************************************

void lte_conn_ind_handler(const struct lte_lc_evt *const evt)
{
	uart_shell = shell_backend_uart_get_ptr();
	switch (evt->type) {
	case LTE_LC_EVT_NW_REG_STATUS:
		switch (evt->nw_reg_status) {
		case LTE_LC_NW_REG_NOT_REGISTERED:
			shell_print(
				uart_shell,
				"Network registration status: not registered");
			break;
		case LTE_LC_NW_REG_SEARCHING:
			shell_print(uart_shell,
				   "Network registration status: searching");
			break;
		case LTE_LC_NW_REG_REGISTRATION_DENIED:
			shell_print(uart_shell,
				   "Network registration status: denied");
			break;
		case LTE_LC_NW_REG_UNKNOWN:
			shell_print(uart_shell,
				   "Network registration status: unknown");
			break;
		case LTE_LC_NW_REG_UICC_FAIL:
			shell_print(uart_shell,
				   "Network registration status: UICC fail");
			break;
		case LTE_LC_NW_REG_REGISTERED_HOME:
		case LTE_LC_NW_REG_REGISTERED_ROAMING:
			shell_print(
				uart_shell, "Network registration status: %s",
				evt->nw_reg_status ==
						LTE_LC_NW_REG_REGISTERED_HOME ?
					"Connected - home network" :
					"Connected - roaming");
#if defined(CONFIG_MODEM_INFO)
			k_work_submit(&modem_info_work);
#endif
		default:
			break;
		}
		break;
	case LTE_LC_EVT_CELL_UPDATE:
		shell_print(uart_shell, "LTE cell changed: Cell ID: %d, Tracking area: %d",
		       evt->cell.id, evt->cell.tac);
		break;
	default:
		break;
	}
}
//**************************************************************************
```

## src/lte_connection.h
```c
#ifndef LTE_CONNECTION_H
#define LTE_CONNECTION_H
#include <shell/shell.h>

void lte_conn_init(void);
void lte_conn_ind_handler(const struct lte_lc_evt *const evt);
int lte_conn_shell(const struct shell *shell, size_t argc, char **argv);

#endif
```

## src/lte_connection_tools.c
```c
#include <stdio.h>
#include <stdlib.h>
#include <string.h>

#include <sys/types.h>
#include <shell/shell.h>

#include <modem/modem_info.h>

#include <posix/arpa/inet.h>
#include <net/net_ip.h>

#include "utils/fta_net_utils.h"
#include "lte_connection_tools.h"

#if defined(CONFIG_AT_CMD)

#include <modem/at_cmd.h>
#include <modem/at_cmd_parser.h>
#include <modem/at_params.h>

#define AT_CMD_BUFFER_LEN (CONFIG_AT_CMD_RESPONSE_MAX_LEN + 1)
#define AT_CMD_PDP_CONTEXT_READ	"AT+CGDCONT?"
#define AT_CMD_PDP_CONTEXT_READ_PARAM_COUNT 12
#define AT_CMD_PDP_CONTEXT_READ_CID_INDEX 1
#define AT_CMD_PDP_CONTEXT_READ_PDP_TYPE_INDEX 2
#define AT_CMD_PDP_CONTEXT_READ_APN_INDEX 3
#define AT_CMD_PDP_CONTEXT_READ_PDP_ADDR_INDEX 4

int lte_conn_pdp_context_read(pdp_context_info_t *populated_info)
{
	int ret = 0;
	struct at_param_list param_list = {0};
	size_t param_str_len;
	char at_response_str[MODEM_INFO_MAX_RESPONSE_SIZE];

	ret = at_cmd_write(AT_CMD_PDP_CONTEXT_READ, at_response_str, sizeof(at_response_str), NULL);
	if (ret) {
		printf("at_cmd_write returned err: %d", ret);
		return ret;
	}
	//printf("%s", at_response_str);

	//TODO: support for multiple contexts, i.e. multiline response, to be something like:
	//while ((ip_str_end = strstr(ip_str_end, AT_CMD_RSP_DELIM)) != NULL) {

	ret = at_params_list_init(&param_list, AT_CMD_PDP_CONTEXT_READ_PARAM_COUNT);
	if (ret) {
		printf("Could init AT params list, error: %d", ret);
		return ret;
	}
	ret = at_parser_max_params_from_str(at_response_str, NULL, &param_list, AT_CMD_PDP_CONTEXT_READ_PARAM_COUNT);
	if (ret) {
		printf("Could not parse AT response, error: %d", ret);
		goto clean_exit;
	}

	ret = at_params_int_get(&param_list, AT_CMD_PDP_CONTEXT_READ_CID_INDEX, &populated_info->cid);
	if (ret) {
		printf("Could not parse CID, err: %d", ret);
		goto clean_exit;
	}

	//TODO: read len 1st and malloc??

	param_str_len = sizeof(populated_info->pdp_type_str);
	ret = at_params_string_get(&param_list,
				   AT_CMD_PDP_CONTEXT_READ_PDP_TYPE_INDEX,
				   populated_info->pdp_type_str,
				   &param_str_len);
	if (ret) {
		printf("Could not parse pdp type, err: %d", ret);
		goto clean_exit;
	}
    else {
	    populated_info->pdp_type_str[param_str_len] = '\0';
        populated_info->pdp_type = PDP_TYPE_UNKNOWN;
        if (strcmp(populated_info->pdp_type_str, "IPV4V6") == 0) {
            populated_info->pdp_type = PDP_TYPE_IP4V6;
        }
        else if (strcmp(populated_info->pdp_type_str, "IPV6") == 0) {
            populated_info->pdp_type = PDP_TYPE_IPV6;
        }
        else if (strcmp(populated_info->pdp_type_str, "IPV4") == 0) {
            populated_info->pdp_type = PDP_TYPE_IPV4;
        }
        printf("pdp type: %c", populated_info->pdp_type);
    }


	param_str_len = sizeof(populated_info->apn_str);
	ret = at_params_string_get(&param_list,
				   AT_CMD_PDP_CONTEXT_READ_APN_INDEX,
				   populated_info->apn_str,
				   &param_str_len);
	if (ret) {
		printf("Could not parse apn str, err: %d", ret);
		goto clean_exit;
	}
	populated_info->apn_str[param_str_len] = '\0';

	param_str_len = sizeof(populated_info->ip_addr_str);
	ret = at_params_string_get(&param_list,
				   AT_CMD_PDP_CONTEXT_READ_PDP_ADDR_INDEX,
				   populated_info->ip_addr_str,
				   &param_str_len);
	if (ret) {
		printf("Could not parse apn str, err: %d", ret);
		goto clean_exit;
	}
	populated_info->ip_addr_str[param_str_len] = '\0';

	/* Parse IP addresses from space delimited string: */
	{
		char *tmp = malloc(strlen(populated_info->ip_addr_str) + 1);
		char *ip_address1, *ip_address2;

		strcpy(tmp, populated_info->ip_addr_str);

		/* Get 1st 2 IP addresses from a CGDCONT string: */
		ip_address1 = strtok(tmp, " ");
		ip_address2 = strtok(NULL, " ");

		if (ip_address1 != NULL) {
			int family = fta_net_utils_sa_family_from_ip_string(ip_address1);
			if (family == AF_INET) {
				struct sockaddr_in *sin = &populated_info->sin4;
				(void)inet_pton(AF_INET, ip_address1, &(sin->sin_addr));
				sin->sin_family = AF_INET;
			}
			else if (family == AF_INET6) {
				struct sockaddr_in6 *sin6 = &populated_info->sin6;

				(void)inet_pton(AF_INET6, ip_address1, &(sin6->sin6_addr));
				sin6->sin6_family = AF_INET6;
			}
		}
		if (ip_address2 != NULL) {
			/* note: if we are here, PDP_addr_2 should be IPv6, thus in following ipv4 branch should not 
			   be possible: */
			int family = fta_net_utils_sa_family_from_ip_string(ip_address2);
			if (family == AF_INET) {
				struct sockaddr_in *sin = &populated_info->sin4;
				(void)inet_pton(AF_INET, ip_address2, &(sin->sin_addr));
				sin->sin_family = AF_INET;
			}
			else if (family == AF_INET6) {
				struct sockaddr_in6 *sin6 = &populated_info->sin6;

				(void)inet_pton(AF_INET6, ip_address2, &(sin6->sin6_addr));
				sin6->sin6_family = AF_INET6;
			}
		}
		free(tmp);
	}

clean_exit:
	at_params_list_free(&param_list);

	return ret;
}

#endif /* CONFIG_AT_CMD */

#if defined(CONFIG_MODEM_INFO)
void lte_conn_modem_info_get_for_shell(const struct shell *shell)
{
	int ret;
	char info_str[MODEM_INFO_MAX_RESPONSE_SIZE];

	pdp_context_info_t pdp_context_info;
	
	ret = modem_info_string_get(MODEM_INFO_OPERATOR, info_str, sizeof(info_str));
	if (ret >= 0) {
		shell_print(shell, "Operator: %s", info_str);
	} else {
		shell_error(shell, "\nUnable to obtain modem operator parameters (%d)", ret);
	}

	ret = modem_info_string_get(MODEM_INFO_FW_VERSION, info_str, sizeof(info_str));
	if (ret >= 0) {
		shell_print(shell, "Modem FW version: %s", info_str);
	} else {
		shell_error(shell, "\nUnable to obtain modem ip parameters (%d)", ret);
	}

#if defined(CONFIG_AT_CMD)
    memset(&pdp_context_info, 0, sizeof(pdp_context_info_t));
	ret = lte_conn_pdp_context_read(&pdp_context_info);
	if (ret >= 0) {
		char ipv4_addr[NET_IPV4_ADDR_LEN];		
		char ipv6_addr[NET_IPV6_ADDR_LEN];

		inet_ntop(AF_INET,  &(pdp_context_info.sin4.sin_addr), ipv4_addr, sizeof(ipv4_addr));
		inet_ntop(AF_INET6, &(pdp_context_info.sin6.sin6_addr), ipv6_addr, sizeof(ipv6_addr));
		
		/* Parsed PDP context info: */	
		shell_print(shell, 
					"Parsed PDP context info:\n"
					"  CID:                    %d\n"
					"  PDP type:               %s\n"
					"  APN:                    %s\n"
//					"  IP address(es) string:  %s\n"
					"  IPv4 address:           %s\n"
					"  IPv6 address:           %s",					
						pdp_context_info.cid, 
						pdp_context_info.pdp_type_str, 
						pdp_context_info.apn_str, 
//						pdp_context_info.ip_addr_str,
						ipv4_addr,
						ipv6_addr);
	} else {
		shell_error(shell, "\nUnable to obtain pdp context info (%d)", ret);
	}
#endif /* CONFIG_AT_CMD */

}
#endif /* CONFIG_MODEM_INFO */
```

## src/lte_connection_tools.h
```c
#ifndef LTE_CONNECTION_TOOLS_H
#define LTE_CONNECTION_TOOLS_H

#include <sys/types.h>
#include <net/net_ip.h>
#include <shell/shell.h>

#define PDP_TYPE_UNKNOWN     0x00
#define PDP_TYPE_IPV4        0x01
#define PDP_TYPE_IPV6        0x02
#define PDP_TYPE_IP4V6       0x03

#define AT_CMD_PDP_CONTEXT_READ_PDP_TYPE_STR_MAX_LEN (6 + 1)
#define AT_CMD_PDP_CONTEXT_READ_APN_STR_MAX_LEN (255)
#define AT_CMD_PDP_CONTEXT_READ_IP_ADDR_STR_MAX_LEN (255)

typedef struct {
	uint32_t cid;
	char pdp_type_str[AT_CMD_PDP_CONTEXT_READ_PDP_TYPE_STR_MAX_LEN];
	char apn_str[AT_CMD_PDP_CONTEXT_READ_APN_STR_MAX_LEN];
	char ip_addr_str[AT_CMD_PDP_CONTEXT_READ_IP_ADDR_STR_MAX_LEN];
    char pdp_type;
	struct sockaddr_in sin4;
	struct sockaddr_in6 sin6;
} pdp_context_info_t;

#if defined(CONFIG_MODEM_INFO)
void lte_conn_modem_info_get_for_shell(const struct shell *shell);
#endif
#if defined(CONFIG_AT_CMD)
int lte_conn_pdp_context_read(pdp_context_info_t *populated_info);
#endif

#endif /* LTE_CONNECTION_TOOLS_H */
```

## src/shell.c
```c
/*
 * Copyright (c) 2020 Nordic Semiconductor ASA
 *
 * SPDX-License-Identifier: LicenseRef-BSD-5-Clause-Nordic
 */

#include <stdlib.h>

#include <shell/shell.h>
#include <modem/lte_lc.h>
#include "at/at_shell.h"
#if defined (CONFIG_FTA_PING)
#include "ping/icmp_ping_shell.h"
#endif
#if defined (CONFIG_FTA_SOCK)
#include "sock/sock_shell.h"
#endif
#if defined (CONFIG_POSIX_API)
#include <sys/select.h>
#else
#if !defined (CONFIG_NET_SOCKETS_POSIX_NAMES)
#include <posix/sys/select.h>
#endif
#endif
#if defined (CONFIG_FTA_IPERF3)
#include "iperf/iperf_api.h"
#endif
#if defined (CONFIG_FTA_LTELC)
#include "ltelc_shell.h"
#endif
#if defined (CONFIG_FTA_CURL)	
#include "fta_curl.h"
#endif
#if defined (CONFIG_FTA_GNSS)
#include "gnss/gnss_shell.h"
#endif
#if defined(CONFIG_FTA_PPP)
#include "ppp/ppp_shell.h"
#endif

const struct shell* shell_global;


#if defined (CONFIG_FTA_IPERF3)	
static int cmd_iperf3(const struct shell *shell, size_t argc, char **argv)
{
	(void)iperf_main(argc, argv);
	return 0;
}
#endif

#if defined (CONFIG_FTA_CURL)	
static int cmd_curl(const struct shell *shell, size_t argc, char **argv)
{
	(void)curl_tool_main(argc, argv);
	shell_print(shell, "\nDONE");
	return 0;
}
SHELL_CMD_REGISTER(curl, NULL, "For curl usage, just type \"curl --manual\"", cmd_curl);
#endif

SHELL_CMD_REGISTER(at, NULL, "Execute an AT command.", at_shell);

#if defined (CONFIG_FTA_SOCK)
SHELL_CMD_REGISTER(sock, NULL,
	"Commands for socket operations such as connect and send.",
	sock_shell);
#endif

#if defined (CONFIG_FTA_PING)
SHELL_CMD_REGISTER(ping, NULL, "For ping usage, just type \"ping\"", icmp_ping_shell);
#endif

#if defined (CONFIG_FTA_LTELC)
SHELL_CMD_REGISTER(ltelc, NULL,
	"Commands for LTE link controlling and status information.",
	ltelc_shell);
#endif

#if defined (CONFIG_FTA_IPERF3)
SHELL_CMD_REGISTER(iperf3, NULL, "For iperf3 usage, just type \"iperf3 --manual\"", cmd_iperf3);
#endif

#if defined (CONFIG_FTA_GNSS)
SHELL_CMD_REGISTER(gnss, NULL,
	"Commands for controlling GNSS.",
	gnss_shell);
#endif

#if defined (CONFIG_FTA_PPP)
SHELL_CMD_REGISTER(ppp, NULL,
	"Commands for controlling FTA PPP.",
	ppp_shell_cmd);
#endif
```

## src/socket.h
```c
#ifndef SOCKET_H
#define SOCKET_H

int socket_shell(const struct shell *shell, size_t argc, char **argv);

#endif
```
