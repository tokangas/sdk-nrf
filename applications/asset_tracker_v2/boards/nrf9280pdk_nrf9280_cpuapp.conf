## applications/asset_tracker_v2/boards/nrf9280pdk_nrf9280_cpuapp.conf
```kconfig
CONFIG_DCACHE=n
CONFIG_NRFS=n

CONFIG_SECURE_BOOT=n
CONFIG_IMG_MANAGER=n
CONFIG_SETTINGS_NVS=y
CONFIG_NVS=y
CONFIG_CAF_LEDS=n
CONFIG_LED_CONTROL=n
CONFIG_WATCHDOG_APPLICATION=n
CONFIG_NRF_CLOUD_FOTA=n
CONFIG_AT_HOST_LIBRARY=n
CONFIG_FOTA_DOWNLOAD=n
CONFIG_FW_INFO=n

CONFIG_NRF_CLOUD_CLIENT_ID_SRC_COMPILE_TIME=y
CONFIG_NRF_CLOUD_CLIENT_ID="nrf-359746166786272"
```

## boards/arm/nrf9160_pca20035/Kconfig
```kconfig
# Kconfig - nRF91 PCA20035 board configuration
#
# Copyright (c) 2019 Nordic Semiconductor ASA
#
# SPDX-License-Identifier: LicenseRef-BSD-5-Clause-Nordic

config BOARD_NRF9160_PCA20035
	bool

config BOARD_NRF9160_PCA20035NS
	bool

config BOARD_NRF9160_PCA20035NS_USE_LEGACY_MAGPIO
	bool "Use legacy MAGPIO for HW v0.3.0"

module=BOARD
module-dep=LOG
module-str=Log level for board
source "${ZEPHYR_BASE}/subsys/logging/Kconfig.template.log_config"
```

## ext/freebsd-getopt/Kconfig
```kconfig
#
# Copyright (c) 2020 Nordic Semiconductor
#
# SPDX-License-Identifier: LicenseRef-BSD-5-Clause-Nordic
#

# Getopt Library for Zephyr

config  GETOPT_LIB
	bool "Getopt library"
	default n
	help
	  Enable the Getopt Library
```

## ext/iperf3/Kconfig
```kconfig
#
# Copyright (c) 2020 Nordic Semiconductor
#
# SPDX-License-Identifier: LicenseRef-BSD-5-Clause-Nordic
#

# iperf3 NCS integration

config  NCS_IPERF3
	bool "Iperf3 NCS integration"
	default n
	help
	  Enable Iperf3 NCS integration

if NCS_IPERF3
menu "NCS iperf3 selections"

config FTA_IPERF3_HOST_NAME
	string "configure host name for iperf3 to be sent as a part of cookie"
	default "nrf9160"

config FTA_IPERF3_RESULTS_WAIT_TIME
	int "Configure the time to be waited to send and recv results"
	default 15

config FTA_IPERF3_CLIENT_TEST_START_TIME
	int "Configure the time to be waited after ctrl socket has been created to actual test start"
	default 15

#invisible configs:
config FTA_IPERF3_NONBLOCKING_CLIENT_CHANGES
	bool
    default y

config FTA_IPERF3_FUNCTIONAL_CHANGES
	bool
    default y

config FTA_IPERF3_MULTICONTEXT_SUPPORT
	bool
    default y
	depends on FTA_IPERF3_FUNCTIONAL_CHANGES

endmenu #NCS iperf3
endif #NCS_IPERF3
```

## lib/modem_fota/Kconfig
```kconfig
#
# Copyright (c) 2020 Nordic Semiconductor ASA
#
# SPDX-License-Identifier: LicenseRef-BSD-5-Clause-Nordic
#

menuconfig MODEM_FOTA
	bool "nRF91 modem FOTA library"
	select BSD_LIBRARY
	select AT_CMD_PARSER

if MODEM_FOTA

config MODEM_FOTA_DM_SERVER_HOST
	string "FOTA Device Management host name"
	default "fota.nrfcloud.com"
	help
		FOTA Device Management server host name.

config MODEM_FOTA_DM_SERVER_PORT
	int "FOTA Device Management port number"
	default 443
	help
		FOTA Device Management server port number.

config MODEM_FOTA_ACCESS_POINT_NAME
	string "FOTA APN"
	default ""
	help
		Acccess Point Name to be used for all FOTA data traffic. If not set, the
		default APN will be used.

config MODEM_FOTA_UPDATE_CHECK_INTERVAL
	int "Interval in minutes between modem firmware update checks"
	default 20160
	help
		Sets the time between modem firmware update checks. The default
		interval is 14 days (20160 minutes).

config MODEM_FOTA_UPDATE_CHECK_INTERVAL_RANDOMNESS
	int "Maximum value in minutes for random component which is added to the update check interval"
	default 1440
	help
		For example if value is set to 1440 minutes, a random component between
		0 and 24 hours is added to the firmware update check timer. If set to 0,
		no randomness is added.

config MODEM_FOTA_DOWNLOAD_TLS_SECURITY_TAG
	int "Security tag to use TLS for the firmware download"
	depends on DOWNLOAD_CLIENT_TLS
	default -1
	help
		Security tag to be used for TLS connection for the firmware download. If
		set to -1, no TLS is used.

config MODEM_FOTA_ALLOWED_DURING_ROAMING
	bool "FOTA allowed during roaming"
	default y
	help
		Is FOTA allowed when device is connected to a roaming network.

config MODEM_FOTA_DISABLE_IMSI_PREFIXES
	string "Comma separated list of USIM IMSI prefixes for which FOTA is disabled"
	default ""
	help
		Comma separated list of IMSI prefixes for USIMs for which FOTA is
		disabled. No whitespace is allowed in the string.

config MODEM_FOTA_SHELL
	bool "Enable shell interface"
	depends on SHELL
	default n
	help
		Enable shell interface for the FOTA Client.

module=MODEM_FOTA
module-dep=LOG
module-str=Modem Firmware Over the Air client
source "${ZEPHYR_BASE}/subsys/logging/Kconfig.template.log_config"

endif # MODEM_FOTA
```

## lib/sms/Kconfig
```kconfig
#
# Copyright (c) 2019 Nordic Semiconductor ASA
#
# SPDX-License-Identifier: LicenseRef-Nordic-5-Clause
#

menuconfig SMS
	bool "SMS subscriber"
	imply AT_CMD
	imply AT_CMD_PARSER
	imply AT_NOTIF
	help
	  A library for managing SMS subscriptions.

if SMS

config SMS_SUBSCRIBERS_MAX_CNT
	int "Maximum number of subscribers"
	default 2
	help
	  Maximum number of subscribers that can register to SMS library.

config SMS_SEND_CONCATENATED_MSG_MAX_CNT
	int "Maximum number of concatenated messages for sending"
	range 2 100
	default 2
	help
	  Maximum number of concatenated messages that the library is able to
	  compose for sending. If there would be even more data to send,
	  an error is returned.

module=SMS
module-dep=LOG
module-str= SMS library
source "${ZEPHYR_BASE}/subsys/logging/Kconfig.template.log_config"

endif # SMS
```
