## CMakeLists.txt
```
#
# Copyright (c) 2020 Nordic Semiconductor
#
# SPDX-License-Identifier: LicenseRef-Nordic-5-Clause
#

cmake_minimum_required(VERSION 3.8.2)

#configuration for secure side
if (EXISTS "${CMAKE_CURRENT_SOURCE_DIR}/spm.conf")
  set(spm_CONF_FILE
    prj.conf
    ${CMAKE_CURRENT_LIST_DIR}/spm.conf
  )
endif()

#if(CONFIG_POSIX_API)
#  target_include_directories(posix_subsys INTERFACE ${ZEPHYR_BASE}/include/posix)
#endif()

find_package(Zephyr REQUIRED HINTS $ENV{ZEPHYR_BASE})
project(MOSH)
target_include_directories(app PRIVATE
  ${CMAKE_CURRENT_SOURCE_DIR}/src
  ${CMAKE_CURRENT_SOURCE_DIR}/iperf
  ${CMAKE_CURRENT_SOURCE_DIR}/ping
  ${CMAKE_CURRENT_SOURCE_DIR}/utils)

if (DEFINED ENV{BUILD_ID})
  zephyr_compile_definitions(
    BUILD_ID=$ENV{BUILD_ID}
  )
endif()

if (DEFINED ENV{BUILD_VARIANT})
  zephyr_compile_definitions(
    BUILD_VARIANT=$ENV{BUILD_VARIANT}
  )
endif()

target_sources(app PRIVATE src/main.c)
target_sources(app PRIVATE src/shell.c)
target_sources(app PRIVATE src/at/at_shell.c)

add_subdirectory(src/utils)
add_subdirectory_ifdef(CONFIG_MOSH_SOCK src/sock)
add_subdirectory_ifdef(CONFIG_MOSH_LTELC src/ltelc)
add_subdirectory_ifdef(CONFIG_MOSH_PING src/ping)
add_subdirectory_ifdef(CONFIG_MOSH_CURL src/curl)
add_subdirectory_ifdef(CONFIG_MOSH_GNSS src/gnss)
add_subdirectory_ifdef(CONFIG_MOSH_SMS src/sms)
add_subdirectory_ifdef(CONFIG_MOSH_PPP src/ppp)
add_subdirectory_ifdef(CONFIG_MOSH_FOTA src/fota)
```

## Kconfig
```
#
# Copyright (c) 2020 Nordic Semiconductor ASA
#
# SPDX-License-Identifier: LicenseRef-Nordic-5-Clause
#

source "Kconfig.zephyr"

menu "Nordic Modem Shell config"

config MOSH_IPERF3
	bool  "Enable iperf3 support"
    default y
	select NRF_IPERF3

config MOSH_SOCK
	bool  "Enable socket tool support"
    default y

config MOSH_PING
	bool  "Enable ICMP ping support"
    default y

config MOSH_LTELC
	bool  "Enable LTE link control support"
    depends on LTE_LINK_CONTROL
    depends on SETTINGS
    default y

config MOSH_CURL
	bool  "Enable CURL"
    default y

config MOSH_GNSS
	bool  "Enable GNSS support"
	default y

config MOSH_PPP
	bool  "Enable PPP support"
	default n

config MOSH_SMS
	bool  "Enable SMS support"
    default y

config MOSH_FOTA
	bool "Enable FOTA support"
	default y

if MOSH_LTELC
menu "MoSH LTELC command selections"

config MOSH_LTELC_SETT_NORMAL_MODE_AT_CMD_STR_LEN
	int "configure string length for custom AT cmds stored in settings and used when going to normal mode"
	default 127

endmenu	
endif #MOSH_LTELC

if MOSH_CURL
menu "MOSH CURL selections"

#invisible configs:
config MOSH_CURL_LIB
	bool
    default y

config MOSH_CURL_TOOL
	bool
    default y

config MOSH_CURL_FUNCTIONAL_CHANGES
	bool
    default y

endmenu #MOSH_CURL
endif #MOSH_CURL

choice MOSH_GNSS_API
	bool "Used GNSS API"
	depends on MOSH_GNSS
	default MOSH_GNSS_API_SOCKET
	help
	  Used GNSS API type.

config MOSH_GNSS_API_SOCKET
	bool "GNSS socket API"

config MOSH_GNSS_API_GPS_DRIVER
	bool "GPS driver"

endchoice

config MOSH_GNSS_ENABLE_LNA
	bool "Enable Low Noise Amplifier (LNA) during startup"
	depends on MOSH_GNSS

endmenu # Modem Shell

#menu "Zephyr Kernel"
#source "Kconfig.zephyr"
#endmenu
```

## prj.conf
```kconfig
#
# Copyright (c) 2020 Nordic Semiconductor ASA
#
# SPDX-License-Identifier: LicenseRef-Nordic-5-Clause
#
# General config

CONFIG_MOSH_IPERF3=y
CONFIG_MOSH_SOCK=y
CONFIG_MOSH_PING=y
CONFIG_MOSH_CURL=y
CONFIG_MOSH_LTELC=y
CONFIG_MOSH_GNSS=y
#CONFIG_MOSH_GNSS_API_GPS_DRIVER=y
#CONFIG_MOSH_GNSS_ENABLE_LNA=y
CONFIG_MOSH_SMS=y

#ref: https://docs.zephyrproject.org/1.13.0/reference/kconfig/CONFIG_SYS_CLOCK_TICKS_PER_SEC.html#cmdoption-arg-config-sys-clock-ticks-per-sec
#CONFIG_SYS_CLOCK_TICKS_PER_SEC=1000 #b_jh: without this there is a default 32k? due to some hw driver?

CONFIG_SHELL=y
CONFIG_SHELL_WILDCARD=n
CONFIG_SHELL_PROMPT_UART="mosh:~$ "

#note: setting this higher caused problems? Some relation to ending handshake timings? Server has closed the connection?
CONFIG_SHELL_ARGC_MAX=16
CONFIG_SHELL_DEFAULT_TERMINAL_WIDTH=160
CONFIG_SHELL_DEFAULT_TERMINAL_HEIGHT=48
# Command line buffer is set this large to enable writing of certificates.
CONFIG_SHELL_CMD_BUFF_SIZE=3072
#CONFIG_SHELL_LOG_LEVEL_DBG=y
#CONFIG_SHELL_PRINTF_BUFF_SIZE=60

# This has impact for modem shell application, not CONFIG_MAIN_STACK_SIZE
CONFIG_SHELL_STACK_SIZE=16384

CONFIG_MINIMAL_LIBC=n
CONFIG_NEWLIB_LIBC=y #needed with CONFIG_MOSH_IPERF3
CONFIG_NEWLIB_LIBC_FLOAT_SCANF=y #needed with CONFIG_MOSH_IPERF3
CONFIG_NEWLIB_LIBC_FLOAT_PRINTF=y #needed with CONFIG_MOSH_IPERF3

# Getopt
CONFIG_GETOPT_LIB=y

# Modem info
CONFIG_MODEM_INFO=y
CONFIG_SMS=y
CONFIG_SMS_LOG_LEVEL_DBG=n

# Network
CONFIG_NETWORKING=y
CONFIG_NET_NATIVE=n
CONFIG_NET_SOCKETS=y
CONFIG_NET_SOCKETS_OFFLOAD=y

CONFIG_POSIX_API=y #needed with CONFIG_MOSH_IPERF3
CONFIG_PTHREAD_IPC=n #b_jh: had issues with posix api, needed as n with CONFIG_MOSH_IPERF3
CONFIG_POSIX_MAX_FDS=10

#need to be the same as MAX_FDS
CONFIG_NET_SOCKETS_POLL_MAX=10

# Modem library
CONFIG_NRF_MODEM_LIB=y
CONFIG_NRF_MODEM_LIB_SYS_INIT=n
CONFIG_NRF_MODEM_LIB_SHMEM_TX_SIZE=16384
CONFIG_NRF_MODEM_LIB_SHMEM_RX_SIZE=8192
#enable for "fidoless"
CONFIG_NRF_MODEM_LIB_TRACE_ENABLED=n

CONFIG_NET_SOCKETS_POSIX_NAMES=n #b_jh: needed as n with CONFIG_MOSH_IPERF3

#for lte connection and other stuff that are using system queue
CONFIG_SYSTEM_WORKQUEUE_STACK_SIZE=8192

# AT commands
CONFIG_AT_CMD=y
CONFIG_AT_CMD_THREAD_STACK_SIZE=2048
#CONFIG_IDLE_STACK_SIZE=1024
#CONFIG_AT_CMD_LOG_LEVEL_DBG=y

#CONFIG_STACK_USAGE=y

# Stacks and heaps
CONFIG_MAIN_STACK_SIZE=4096
CONFIG_HEAP_MEM_POOL_SIZE=10240

# LTE link control
CONFIG_LTE_LINK_CONTROL=y
#CONFIG_LTE_NETWORK_MODE_LTE_M_GPS=y
CONFIG_LTE_NETWORK_DEFAULT=y
CONFIG_LTE_MODE_PREFERENCE_AUTO=y

CONFIG_LTE_AUTO_INIT_AND_CONNECT=n
CONFIG_LTE_NETWORK_USE_FALLBACK=n
CONFIG_LTE_PDP_CMD=n
CONFIG_LTE_PDN_AUTH_CMD=n
#CONFIG_LTE_LOCK_PLMN=y
#CONFIG_LTE_LOCK_PLMN_STRING="24412"

# GNSS SUPL (AGPS) support, needs the nRF9160 SiP SUPL client library from
# nRF9160 DK product page
CONFIG_SUPL_CLIENT_LIB=n

# GPS driver, enable if CONFIG_MOSH_GNSS_API_GPS_DRIVER is enabled
#CONFIG_NRF9160_GPS=y
# Initialize GPS driver before LTE LC
#CONFIG_NRF9160_GPS_INIT_PRIO=40
#CONFIG_NRF9160_GPS_ANTENNA_EXTERNAL=y
#CONFIG_NRF9160_GPS_NMEA_GSV=y
#CONFIG_NRF9160_GPS_NMEA_GSA=y
#CONFIG_NRF9160_GPS_NMEA_GLL=y
#CONFIG_NRF9160_GPS_NMEA_GGA=y
#CONFIG_NRF9160_GPS_NMEA_RMC=y

# FOTA
CONFIG_FLASH=y
CONFIG_REBOOT=y
CONFIG_DFU_TARGET=y
CONFIG_FOTA_DOWNLOAD=y
CONFIG_DOWNLOAD_CLIENT=y
# BOOTLOADER_MCUBOOT reduces usable flash size by half, so these may have to be disabled:
CONFIG_BOOTLOADER_MCUBOOT=n
CONFIG_IMG_MANAGER=n
CONFIG_IMG_ERASE_PROGRESSIVELY=n

#Settings used by mosh ltelc
CONFIG_FLASH=y
CONFIG_FLASH_MAP=y
CONFIG_MPU_ALLOW_FLASH_WRITE=y
CONFIG_NVS=y
CONFIG_SETTINGS=y
CONFIG_SETTINGS_NVS=y
CONFIG_NVS_LOG_LEVEL_WRN=y

# debugging
CONFIG_ASSERT=y
CONFIG_LOG=y
CONFIG_DEBUG_INFO=y
CONFIG_LOG_STRDUP_MAX_STRING=94
#CONFIG_LOG_PROCESS_THREAD_STACK_SIZE=2048

#CONFIG_DEBUG_OPTIMIZATIONS=y
#CONFIG_NO_OPTIMIZATIONS=y

#CONFIG_FORCE_NO_ASSERT=y
CONFIG_ASSERT_VERBOSE=y
#CONFIG_ASSERT_LEVEL=2
#CONFIG_ASSERT_ON_ERRORS=y
#CONFIG_FAULT_DUMP=2
CONFIG_RESET_ON_FATAL_ERROR=n
CONFIG_EXTRA_EXCEPTION_INFO=y
#CONFIG_WATCHDOG=y
```

## overlay-app_fota.conf
```kconfig
# curl needs to be switched off to free enough flash
CONFIG_MOSH_CURL=n

CONFIG_BOOTLOADER_MCUBOOT=y
CONFIG_IMG_MANAGER=y
CONFIG_IMG_ERASE_PROGRESSIVELY=y
```

## overlay-goboard.conf
```kconfig
/*
 * Copyright (c) 2020 Gerson Fernando Budke <nandojve@gmail.com>
 *
 * SPDX-License-Identifier: Apache-2.0
 */


&uart0 {
	status = "okay";
	current-speed = <115200>;
	tx-pin = <15>;
	rx-pin = <14>;
	rts-pin = <13>;
	cts-pin = <16>;
};
```

## overlay-lwm2m.conf
```kconfig
CONFIG_LWM2M_CARRIER=y

CONFIG_FLASH=y
CONFIG_FLASH_PAGE_LAYOUT=y

CONFIG_MPU_ALLOW_FLASH_WRITE=y

CONFIG_NVS=y
CONFIG_NVS_LOG_LEVEL_OFF=y

CONFIG_DOWNLOAD_CLIENT=y

CONFIG_MODEM_KEY_MGMT=y

CONFIG_REBOOT=y

# Modem shell FOTA support needs to be disabled
CONFIG_FTA_FOTA=n
CONFIG_BOOTLOADER_MCUBOOT=n
CONFIG_IMG_MANAGER=n
CONFIG_IMG_ERASE_PROGRESSIVELY=n
```

## overlay-lwm2m_carrier.conf
```kconfig
CONFIG_LWM2M_CARRIER=y

CONFIG_FLASH=y
CONFIG_FLASH_PAGE_LAYOUT=y

CONFIG_MPU_ALLOW_FLASH_WRITE=y

CONFIG_NVS=y
CONFIG_NVS_LOG_LEVEL_OFF=y

CONFIG_DOWNLOAD_CLIENT=y

CONFIG_MODEM_KEY_MGMT=y

CONFIG_REBOOT=y

# Modem shell FOTA support needs to be disabled
CONFIG_MOSH_FOTA=n
CONFIG_BOOTLOADER_MCUBOOT=n
CONFIG_IMG_MANAGER=n
CONFIG_IMG_ERASE_PROGRESSIVELY=n
```

## overlay-ppp.conf
```kconfig
#Enable PPP MoSH support:
CONFIG_MOSH_PPP=y
CONFIG_MOSH_IPERF3=y
CONFIG_MOSH_SOCK=n
CONFIG_MOSH_PING=y
CONFIG_MOSH_CURL=n
CONFIG_MOSH_LTELC=y
CONFIG_MOSH_GNSS=n
CONFIG_MOSH_SMS=n

#CONFIG_SHELL_STACK_SIZE=8192

CONFIG_SMS=n

#UARTs are switched:
CONFIG_UART_SHELL_ON_DEV_NAME="UART_1"
CONFIG_UART_CONSOLE_ON_DEV_NAME="UART_1"
#CONFIG_LOG_BACKEND_UART=y

#CONFIG_MCUBOOT=y
#CONFIG_MCUBOOT_SERIAL=y
#CONFIG_RECOVERY_UART_DEV_NAME="UART_1"

CONFIG_NET_PPP_UART_NAME="UART_0"

#CONFIG_SPM_BOOT_SILENTLY=y

#seems that we need more stack for system workqueue:
#CONFIG_SYSTEM_WORKQUEUE_STACK_SIZE=10240
#CONFIG_MAIN_STACK_SIZE=2048

#enable net shell commands
CONFIG_NET_SHELL=y
CONFIG_NET_STATISTICS_PPP=y
CONFIG_NET_STATISTICS_USER_API=y

#enable needed stuff from native net stack
CONFIG_NET_NATIVE=y
CONFIG_NET_STATISTICS=y
CONFIG_NET_LOG=y
CONFIG_NET_CONFIG_AUTO_INIT=y

CONFIG_NET_SOCKETS=y
CONFIG_NET_SOCKETS_PACKET=y
CONFIG_NET_SOCKETS_PACKET_DGRAM=n
CONFIG_NET_IF_MAX_IPV4_COUNT=2

CONFIG_NET_IPV4=y
CONFIG_NET_IPV6=n
CONFIG_NET_OFFLOAD=y

CONFIG_NET_IP_ADDR_CHECK=n

#default PPP net_if
CONFIG_NET_DEFAULT_IF_PPP=y

#UART PPP driver
CONFIG_NET_PPP=y
CONFIG_NET_PPP_DRV_NAME="ppp"
CONFIG_NET_PPP_UART_BUF_LEN=16
CONFIG_NET_PPP_RINGBUF_SIZE=8192
CONFIG_NET_PPP_RX_STACK_SIZE=2048
CONFIG_NET_PPP_VERIFY_FCS=n

#L2 protocol configs
CONFIG_NET_L2_PPP=y
CONFIG_NET_L2_PPP_MGMT=y
CONFIG_NET_L2_PPP_DELAY_STARTUP_MS=5000

CONFIG_NET_L2_PPP_OPTION_MRU=y
CONFIG_NET_L2_PPP_OPTION_SERVE_IP=y
CONFIG_NET_L2_PPP_OPTION_SERVE_DNS=y

#windows support
CONFIG_PPP_CLIENT_CLIENTSERVER=y

#our new PPP MRU option config, this needs to be in synch with net pkt configs
CONFIG_NET_PPP_MTU_MRU=1280


# Network buffers
CONFIG_NET_BUF=y

CONFIG_NET_PKT_RX_COUNT=110
CONFIG_NET_BUF_RX_COUNT=180

CONFIG_NET_PKT_TX_COUNT=100
CONFIG_NET_BUF_TX_COUNT=170

CONFIG_NET_BUF_DATA_SIZE=64

CONFIG_NET_BUF_POOL_USAGE=y



CONFIG_NRF_MODEM_LIB_TRACE_ENABLED=n

# Debug options
#CONFIG_LOG_RUNTIME_FILTERING=n
CONFIG_NET_IPV4_LOG_LEVEL_WRN=y
CONFIG_NET_PPP_LOG_LEVEL_WRN=y
CONFIG_NET_L2_PPP_LOG_LEVEL_WRN=y
CONFIG_NET_CORE_LOG_LEVEL_WRN=y
CONFIG_NET_IF_LOG_LEVEL_WRN=y

CONFIG_NET_PKT_LOG_LEVEL_WRN=y
CONFIG_NET_DEBUG_NET_PKT_ALLOC=y

CONFIG_NET_CONTEXT_LOG_LEVEL_WRN=y
CONFIG_UART_CONSOLE_LOG_LEVEL_WRN=y
CONFIG_NET_BUF_LOG_LEVEL_WRN=y
CONFIG_NET_BUF_LOG=y
CONFIG_NET_BUF_WARN_ALLOC_INTERVAL=2

# debugging, does not yet work decently with asserts
CONFIG_ASSERT=y
CONFIG_RESET_ON_FATAL_ERROR=n
CONFIG_LOG_PROCESS_THREAD_STACK_SIZE=4096
```

## spm.conf
```kconfig
CONFIG_LOG=y
CONFIG_LOG_MODE_MINIMAL=y
CONFIG_RESET_ON_FATAL_ERROR=n
```

## src/main.c
```c
/*
 * Copyright (c) 2020 Nordic Semiconductor ASA
 *
 * SPDX-License-Identifier: LicenseRef-Nordic-5-Clause
 */

#include <stdio.h>
#include <string.h>

#include <zephyr.h>
#include <init.h>
#include <nrf_modem.h>

#include <sys/types.h>
#include <nrf9160.h>
#include <hal/nrf_gpio.h>
#include <logging/log_ctrl.h>
#include <power/reboot.h>
#include <dfu/mcuboot.h>

#include <modem/nrf_modem_lib.h>
#include <modem/at_cmd.h>
#include <modem/at_notif.h>
#include <modem/modem_info.h>
#include <modem/lte_lc.h>

#include "private.h"

#if defined(CONFIG_MOSH_PPP)
#include <shell/shell.h>
#include "ppp_ctrl.h"
#endif

#if defined(CONFIG_MOSH_LTELC)
#include "ltelc.h"
#endif

#if defined(CONFIG_MOSH_GNSS)
#include "gnss.h"
#endif

#if defined(CONFIG_MOSH_FOTA)
#include "fota.h"
#endif

/* global variables */
struct modem_param_info modem_param;

K_SEM_DEFINE(nrf_modem_lib_initialized, 0, 1);

#if !defined (CONFIG_RESET_ON_FATAL_ERROR)
#if 0
void k_sys_fatal_error_handler(unsigned int reason,
			       const z_arch_esf_t *esf)
{
//	ARG_UNUSED(esf);

	LOG_PROCESS();
	LOG_PANIC();
	printk("OHO! Running main.c error handler, reason: %d", reason);
	z_fatal_error(reason, esf);
//	k_fatal_halt(reason);
//	CODE_UNREACHABLE;
}
#endif
#endif

static void mosh_print_version_info(void)
{
#if defined(APP_VERSION)
	printk("\nMOSH version:       %s", STRINGIFY(APP_VERSION));
#else
	printk("\nMOSH version:       unknown");
#endif

#if defined(BUILD_ID)
	printk("\nMOSH build id:      v%s", STRINGIFY(BUILD_ID));
#else
	printk("\nMOSH build id:      custom");
#endif

#if defined(BUILD_VARIANT)
#if defined(BRANCH_NAME)
	printk("\nMOSH build variant: %s/%s\n\n", STRINGIFY(BRANCH_NAME), STRINGIFY(BUILD_VARIANT));
#else
	printk("\nMOSH build variant: %s\n\n", STRINGIFY(BUILD_VARIANT));
#endif
#else
	printk("\nMOSH build variant: dev\n\n");
#endif
}

void main(void)
{
	int err;

	mosh_print_version_info();

	/* Initialize private parts of the application */
	private_initialization();

#if !defined(CONFIG_LWM2M_CARRIER)
	printk("Initializing modemlib...\n");
	err = nrf_modem_lib_init(NORMAL_MODE);
	switch (err) {
	case MODEM_DFU_RESULT_OK:
		printk("Modem firmware update successful!\n");
		printk("Modem will run the new firmware after reboot\n");
		sys_reboot(SYS_REBOOT_WARM);
		break;
	case MODEM_DFU_RESULT_UUID_ERROR:
	case MODEM_DFU_RESULT_AUTH_ERROR:
		printk("Modem firmware update failed!\n");
		printk("Modem will run non-updated firmware on reboot.\n");
		sys_reboot(SYS_REBOOT_WARM);
		break;
	case MODEM_DFU_RESULT_HARDWARE_ERROR:
	case MODEM_DFU_RESULT_INTERNAL_ERROR:
		printk("Modem firmware update failed!\n");
		printk("Fatal error.\n");
		sys_reboot(SYS_REBOOT_WARM);
		break;
	case -1:
		printk("Could not initialize bsdlib.\n");
		printk("Fatal error.\n");
		return;
	default:
		break;
	}
	printk("Initialized modemlib\n");

	at_cmd_init();
#if !defined (CONFIG_AT_NOTIF_SYS_INIT)
	at_notif_init();
#endif
	lte_lc_init();
#else
	/* Wait until bsdlib has been initialized. */
	k_sem_take(&nrf_modem_lib_initialized, K_FOREVER);

#endif

#if defined(CONFIG_MOSH_GNSS_ENABLE_LNA)
	gnss_set_lna_enabled(true);
#endif

#if defined(CONFIG_MOSH_FOTA)
	err = fota_init();
	if (err) {
		printk("Could not initialize FOTA: %d\n", err);
	}
#endif

#if defined(CONFIG_LTE_LINK_CONTROL) && defined(CONFIG_MOSH_LTELC)
	ltelc_init();
#endif

#if defined(CONFIG_MODEM_INFO)
	err = modem_info_init();
	if (err) {
		printk("\nModem info could not be established: %d", err);
		return;
	}
	modem_info_params_init(&modem_param);
#endif


	/* Application started successfully, mark image as OK to prevent
	 * revert at next reboot.
	 */
#if defined (CONFIG_BOOTLOADER_MCUBOOT )	
	boot_write_img_confirmed();
#endif
}

#if defined (CONFIG_MOSH_PPP)
static int mosh_shell_init(const struct device *unused)
{
	ppp_ctrl_init();
	return 0;
}
SYS_INIT(mosh_shell_init, APPLICATION, CONFIG_APPLICATION_INIT_PRIORITY);
#endif
```

## src/fta_defines.h
```c
/*
 * Copyright (c) 2020 Nordic Semiconductor ASA
 *
 * SPDX-License-Identifier: LicenseRef-BSD-5-Clause-Nordic
 */

#ifndef FTA_DEFINES_H
#define FTA_DEFINES_H

#define FTA_EMPTY_STRING "\0"

#define FTA_APN_STR_MAX_LEN (64)
#define FTA_ARG_NOT_SET -6

#define FTA_STRING_NULL_CHECK(string) ((string != NULL) ? string : FTA_EMPTY_STRING)

#endif /* FTA_DEFINES_H */
```

## src/mosh_defines.h
```c
/*
 * Copyright (c) 2020 Nordic Semiconductor ASA
 *
 * SPDX-License-Identifier: LicenseRef-Nordic-5-Clause
 */

#ifndef MOSH_DEFINES_H
#define MOSH_DEFINES_H

#define MOSH_EMPTY_STRING "\0"

#define MOSH_APN_STR_MAX_LEN (64)
#define MOSH_ARG_NOT_SET -6

#define MOSH_STRING_NULL_CHECK(string) \
	((string != NULL) ? string : MOSH_EMPTY_STRING)

#endif /* MOSH_DEFINES_H */
```

## src/shell.c
```c
/*
 * Copyright (c) 2020 Nordic Semiconductor ASA
 *
 * SPDX-License-Identifier: LicenseRef-Nordic-5-Clause
 */

#include <stdlib.h>

#include <zephyr.h>
#include <shell/shell.h>
#include <shell/shell_uart.h>
#include <modem/lte_lc.h>

#if defined (CONFIG_LWM2M_CARRIER)
#include <lwm2m_carrier.h>
#endif
#include "at/at_shell.h"
#if defined (CONFIG_MOSH_PING)
#include "ping/icmp_ping_shell.h"
#endif
#if defined (CONFIG_MOSH_SOCK)
#include "sock/sock_shell.h"
#endif
#if defined (CONFIG_POSIX_API)
#include <sys/select.h>
#else
#if !defined (CONFIG_NET_SOCKETS_POSIX_NAMES)
#include <posix/sys/select.h>
#endif
#endif
#if defined (CONFIG_MOSH_IPERF3)
#include <iperf_api.h>
#endif
#if defined (CONFIG_MOSH_LTELC)
#include "ltelc_shell.h"
#endif
#if defined (CONFIG_MOSH_CURL)	
#include "mosh_curl.h"
#endif
#if defined (CONFIG_MOSH_GNSS)
#include "gnss/gnss_shell.h"
#endif
#if defined (CONFIG_MOSH_SMS)
#include "sms/sms_shell.h"
#endif
#if defined(CONFIG_MOSH_PPP)
#include "ppp/ppp_shell.h"
#endif

const struct shell* shell_global;

extern struct k_sem nrf_modem_lib_initialized;

void nrf_modem_recoverable_error_handler(uint32_t error)
{
	shell_global = shell_backend_uart_get_ptr();

	shell_error(shell_global, "modem lib recoverable error: %u\n", error);
}

#if defined (CONFIG_LWM2M_CARRIER)
void lwm2m_print_err(const lwm2m_carrier_event_t *evt)
{
	const lwm2m_carrier_event_error_t *err =
		(lwm2m_carrier_event_error_t *)evt->data;

	static const char *strerr[] = {
		[LWM2M_CARRIER_ERROR_NO_ERROR] =
			"No error",
		[LWM2M_CARRIER_ERROR_BOOTSTRAP] =
			"Bootstrap error",
		[LWM2M_CARRIER_ERROR_CONNECT_FAIL] =
			"Failed to connect to the LTE network",
		[LWM2M_CARRIER_ERROR_DISCONNECT_FAIL] =
			"Failed to disconnect from the LTE network",
		[LWM2M_CARRIER_ERROR_FOTA_PKG] =
			"Package refused from modem",
		[LWM2M_CARRIER_ERROR_FOTA_PROTO] =
			"Protocol error",
		[LWM2M_CARRIER_ERROR_FOTA_CONN] =
			"Connection to remote server failed",
		[LWM2M_CARRIER_ERROR_FOTA_CONN_LOST] =
			"Connection to remote server lost",
		[LWM2M_CARRIER_ERROR_FOTA_FAIL] =
			"Modem firmware update failed",
	};

	shell_error(shell_global, "%s, reason %d\n", strerr[err->code], err->value);
}

void lwm2m_print_deferred(const lwm2m_carrier_event_t *evt)
{
	const lwm2m_carrier_event_deferred_t *def =
		(lwm2m_carrier_event_deferred_t *)evt->data;

	static const char *strdef[] = {
		[LWM2M_CARRIER_DEFERRED_NO_REASON] =
			"No reason given",
		[LWM2M_CARRIER_DEFERRED_PDN_ACTIVATE] =
			"Failed to activate PDN",
		[LWM2M_CARRIER_DEFERRED_BOOTSTRAP_NO_ROUTE] =
			"No route to bootstrap server",
		[LWM2M_CARRIER_DEFERRED_BOOTSTRAP_CONNECT] =
			"Failed to connect to bootstrap server",
		[LWM2M_CARRIER_DEFERRED_BOOTSTRAP_SEQUENCE] =
			"Bootstrap sequence not completed",
		[LWM2M_CARRIER_DEFERRED_SERVER_NO_ROUTE] =
			"No route to server",
		[LWM2M_CARRIER_DEFERRED_SERVER_CONNECT] =
			"Failed to connect to server",
		[LWM2M_CARRIER_DEFERRED_SERVER_REGISTRATION] =
			"Server registration sequence not completed",
	};

	shell_error(shell_global, "Reason: %s, timeout: %d seconds\n",
		    strdef[def->reason], def->timeout);
}

int lwm2m_carrier_event_handler(const lwm2m_carrier_event_t *event)
{
	shell_global = shell_backend_uart_get_ptr();

	switch (event->type) {
	case LWM2M_CARRIER_EVENT_BSDLIB_INIT:
		shell_print(shell_global, "LwM2M carrier event: modem lib initialized");
		break;
	case LWM2M_CARRIER_EVENT_CONNECTING:
		shell_print(shell_global, "LwM2M carrier event: connecting");
		k_sem_give(&nrf_modem_lib_initialized);
		break;
	case LWM2M_CARRIER_EVENT_CONNECTED:
		shell_print(shell_global, "LwM2M carrier event: connected");
		break;
	case LWM2M_CARRIER_EVENT_DISCONNECTING:
		shell_print(shell_global, "LwM2M carrier event: disconnecting");
		break;
	case LWM2M_CARRIER_EVENT_DISCONNECTED:
		shell_print(shell_global, "LwM2M carrier event: disconnected");
		break;
	case LWM2M_CARRIER_EVENT_BOOTSTRAPPED:
		shell_print(shell_global, "LwM2M carrier event: bootstrapped");
		break;
	case LWM2M_CARRIER_EVENT_LTE_READY:
		shell_print(shell_global, "LwM2M carrier event: LTE ready");
		break;
	case LWM2M_CARRIER_EVENT_REGISTERED:
		shell_print(shell_global, "LwM2M carrier event: registered");
		break;
	case LWM2M_CARRIER_EVENT_DEFERRED:
		shell_print(shell_global, "LwM2M carrier event: deferred");
		lwm2m_print_deferred(event);
		break;
	case LWM2M_CARRIER_EVENT_FOTA_START:
		shell_print(shell_global, "LwM2M carrier event: fota start");
		break;
	case LWM2M_CARRIER_EVENT_REBOOT:
		shell_print(shell_global, "LwM2M carrier event: reboot");
		break;
	case LWM2M_CARRIER_EVENT_ERROR:
		shell_print(shell_global, "LwM2M carrier event: error");
		lwm2m_print_err(event);
		break;
	}

	return 0;
}
#endif

#if defined (CONFIG_MOSH_IPERF3)	
static int cmd_iperf3(const struct shell *shell, size_t argc, char **argv)
{
	(void)iperf_main(argc, argv);
	return 0;
}
#endif

#if defined (CONFIG_MOSH_CURL)	
static int cmd_curl(const struct shell *shell, size_t argc, char **argv)
{
	(void)curl_tool_main(argc, argv);
	shell_print(shell, "\nDONE");
	return 0;
}
SHELL_CMD_REGISTER(curl, NULL, "For curl usage, just type \"curl --manual\"", cmd_curl);
#endif

SHELL_CMD_REGISTER(at, NULL, "Execute an AT command.", at_shell);

#if defined (CONFIG_MOSH_SOCK)
SHELL_CMD_REGISTER(sock, NULL,
	"Commands for socket operations such as connect and send.",
	sock_shell);
#endif

#if defined (CONFIG_MOSH_PING)
SHELL_CMD_REGISTER(ping, NULL, "For ping usage, just type \"ping\"", icmp_ping_shell);
#endif

#if defined (CONFIG_MOSH_LTELC)
SHELL_CMD_REGISTER(ltelc, NULL,
	"Commands for LTE link controlling and status information.",
	ltelc_shell);
#endif

#if defined (CONFIG_MOSH_IPERF3)
SHELL_CMD_REGISTER(iperf3, NULL, "For iperf3 usage, just type \"iperf3 --manual\"", cmd_iperf3);
#endif

#if defined (CONFIG_MOSH_SMS)
SHELL_CMD_REGISTER(sms, NULL, "Commands for sending and receiving SMS.", sms_shell);
#endif

#if defined (CONFIG_MOSH_PPP)
SHELL_CMD_REGISTER(ppp, NULL,
	"Commands for controlling PPP.",
	ppp_shell_cmd);
#endif

static void disable_uarts()
{
    NRF_UARTE0_NS->TASKS_STOPRX  = 1;
    NRF_UARTE0_NS->TASKS_STOPTX = 1;
    while(NRF_UARTE0_NS->EVENTS_RXTO==0);
    NRF_UARTE0_NS->ENABLE = 0;

    NRF_UARTE1_NS->TASKS_STOPRX  = 1;
    NRF_UARTE1_NS->TASKS_STOPTX = 1;
    while(NRF_UARTE1_NS->EVENTS_RXTO==0);
    NRF_UARTE1_NS->ENABLE = 0;
}

static void enable_uarts()
{
    NRF_UARTE0_NS->ENABLE = 8;
    NRF_UARTE0_NS->TASKS_STARTRX = 1;
    NRF_UARTE0_NS->TASKS_STARTTX = 1;

    NRF_UARTE1_NS->ENABLE = 8;
    NRF_UARTE1_NS->TASKS_STARTRX = 1;
    NRF_UARTE1_NS->TASKS_STARTTX = 1;
}

static int cmd_uart_disable(const struct shell *shell, size_t argc, char **argv)
{
	int sleep_time;

	sleep_time = atoi(argv[1]);
	if (sleep_time < 0) {
		shell_error(shell, "disable: invalid sleep time");
		return -EINVAL;
	}

	if (sleep_time > 0) {
		shell_print(shell, "disable: disabling UARTs for %d seconds", sleep_time);
	} else {
		shell_print(shell, "disable: disabling UARTs indefinitely");
	}

	k_sleep(K_MSEC(500));
	disable_uarts();

	if (sleep_time > 0) {
		k_sleep(K_SECONDS(sleep_time));

		enable_uarts();

		shell_print(shell, "disable: UARTs enabled");
	}

	return 0;
}

SHELL_STATIC_SUBCMD_SET_CREATE(sub_uart,
    SHELL_CMD_ARG(disable, NULL, "<time in seconds>\nDisable UARTs for a given number of seconds. 0 means that UARTs remain disabled indefinitely.", cmd_uart_disable, 2, 0),
    SHELL_SUBCMD_SET_END
);

SHELL_CMD_REGISTER(uart, &sub_uart, "Commands for disabling UARTs for power measurement.", NULL);
```
